## app/command/multicore_memory_test/Kconfig
```kconfig
config CONSUMER_PRODUCER_TEST
	bool "CONSUMER_PRODUCER_TEST"
	default y
config AXI_DMA_TEST
	bool "AXI_DMA_TEST"
	default y
```

## mm/Kconfig
```kconfig
menu "Memory Management"

config TINY
	bool "Enable Tiny mm"
	default y

config COW
	bool "Enable COW"
	default y

config FORK
	bool "Enable fork"
	default y

endmenu
```
